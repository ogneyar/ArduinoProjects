//Wemos D1 Мини
#define SSD1306_ADDRESS            0x3C
//SSD1306 128x64
#define SSD1306_COLUMN             20
#define SSD1306_LINE               8
#include <Wire.h>
// Character set - stored in program memory
const uint8_t CharMap[96][6] PROGMEM = {
{ 0x00, 0x00, 0x00, 0x00, 0x00, 0x00 },
{ 0x00, 0x00, 0x5F, 0x00, 0x00, 0x00 },
{ 0x00, 0x07, 0x00, 0x07, 0x00, 0x00 },
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{ 0xFF, 0xFF, 0xFF, 0xFF, 0xFF, 0x00 }
};
int const InitLen = 23;
unsigned char Init[InitLen] = {
  0xAE, // Display off
  0xD5, // Set display clock
  0x80, // Recommended value
  0xA8, // Set multiplex
  0x3F,
  0xD3, // Set display offset
  0x00,
  0x40, // Zero start line
  0x8D, // Charge pump
  0x14,
  0x20, // Memory mode
  0x02, // Page addressing
  0xA1, // 0xA0/0xA1 flip horizontally
  0xC8, // 0xC0/0xC8 flip vertically
  0xDA, // Set comp ins
  0x12,
  0x81, // Set contrast
  0x7F,
  0xD9, // Set pre charge
  0xF1,
  0xDB, // Set vcom detect
  0x40,
  0xA6  // Normal (0xA7=Inverse)
};
void setup() {
//  Serial.begin(9600);
  Wire.begin(D1, D2);
  InitDisplay();
DisplayStr ("Character set for text - stored in program memory\n\r");
DisplayStr ("Character set for text - stored in program memory\n\r");
DisplayStr ("Character set for text - stored in program memory\n\r");
}

void loop() {
  // put your main code here, to run repeatedly:

}
void Command(uint8_t c)
{
    Wire.beginTransmission(SSD1306_ADDRESS);
    Wire.write(0x80);//command mode
    Wire.write(c);
    Wire.endTransmission();
}

void Data(uint8_t d)
{
    Wire.beginTransmission(SSD1306_ADDRESS);
    Wire.write(0x40);//data mode
    Wire.write(d);
    Wire.endTransmission();
}
void InitDisplay () {
  for (uint8_t c=0; c<InitLen; c++) Command(Init[c]);
  Display(12);    // Clear display
  Command(0xAF);  // Display on
}
// Character terminal **********************************************

void ClearLine (uint8_t line) {
  Command(0xB0 + line);
  Command(0x00); // Column start low
  Command(0x00); // Column start high
  for (uint8_t b = 0 ; b < 128; b++) Data(0);
}

// Clears the top line, then scrolls the display up by one line
void ScrollDisplay (uint8_t *scroll) {
  ClearLine(*scroll);
  *scroll = (*scroll + 1) & 0x07;
  Command(0xD3);
  Command(*scroll << 3);
}

// Plots a character; line = 0 to 7; column = 0 to 20
void PlotChar (char c, uint8_t line, uint8_t column) {
  column = column*6;
  Command(0xB0 + (line & 0x07));
  Command(0x00 + (column & 0x0F)); // Column start low
  Command(0x10 + (column >> 4));   // Column start high
  for (uint8_t col = 0; col < 6; col++) {
    Data(pgm_read_byte(&CharMap[(c & 0x7F)-32][col]));
  }
}

// Prints a character to display, handling control characters
void Display (char c) {
  static uint8_t Line = 0, Column = 0, Scroll = 0;
  if (c >= 32) {                   // Normal character
    PlotChar(c, Line+Scroll, Column++);
    if (Column > SSD1306_COLUMN) {
      Column = 0;
      if (Line == SSD1306_LINE) ScrollDisplay(&Scroll); else Line++;
    }
  } else if (c == 12) {            // Clear display
    for (uint8_t p=0; p < 8; p++) ClearLine(p);
    Line = Scroll;
    Column = 0;
  } else if (c == 13) {            // Return
    Column = 0;
    if (Line == SSD1306_LINE) ScrollDisplay(&Scroll); else Line++;
  }
}
void DisplayStr (char *s) {
  while (*s) Display(*s++);
}
