;
; Blink.asm
;
; Created: 19.02.2023 11:02:52
; Author : Ogneyar
;
; Светодиодная мигалка на микроконтроллере ATtiny104
;
.INCLUDE "E:\VSCode\AsmStudy\AVRasm\ATtiny104\libs\tn104def.inc" ; загрузка предопределений для ATtiny104 
; #include "../../libs/macro.inc" ; подключение файла с макросами

;=================================================
; Имена регистров, а также различные константы
	.equ 	F_CPU 					= 1000000		; Частота МК

	.equ 	PA5 					= 5

	.equ 	Delay 					= 100
	.equ 	Number 					= Delay * 1000 / 5
	
;=================================================
; Сегмент SRAM памяти
.DSEG			
;=================================================
; Сегмент EEPROM памяти
.ESEG
;=================================================
; Сегмент FLASH памяти
.CSEG
;=================================================
; Таблица прерываний
	.ORG 0x000
		RJMP	RESET
		
;=================================================
; Переменные во флеш памяти
; Program_name: .db "Blink on ATtiny104",0

;=================================================
; Прерывание по сбросу, стартовая инициализация 
RESET:	

;=================================================
	; -- инициализация стека -- 
	LDI R16, LOW(RAMEND) ; младший байт конечного адреса ОЗУ в R16 
	OUT SPL, R16 ; установка младшего байта указателя стека 
	LDI R16, HIGH(RAMEND) ; старший байт конечного адреса ОЗУ в R16 
	OUT SPH, R16 ; установка старшего байта указателя стека 

;==============================================================
; Очистка ОЗУ и регистров R0-R31
	LDI		ZL, LOW(SRAM_START)		; Адрес начала ОЗУ в индекс
	LDI		ZH, HIGH(SRAM_START)
	CLR		R16					; Очищаем R16
RAM_Flush:
	ST 		Z+, R16			
	CPI		ZH, HIGH(RAMEND+1)	
	BRNE	RAM_Flush				
	CPI		ZL, LOW(RAMEND+1)	
	BRNE	RAM_Flush
	LDI		ZL, (0x1F-2)			; Адрес регистра R29
	CLR		ZH
Reg_Flush:
	ST		Z, ZH
	DEC		ZL
	BRNE	Reg_Flush
	CLR		ZL
	CLR		ZH
	
;==============================================================
	; -- устанавливаем пин 5 порта A на выход -- 
	SBI DDRA, PA5 ; 
	
;==============================================================
; -- основной цикл программы -- 
Start: 	
	SBI PORTA, PA5 ; подача на пин PB0 высокого уровня 
	RCALL Wait ; вызываем функцию задержки по времени 
	CBI PORTA, PA5 ; подача на пин PB0 низкого уровня 
	RCALL Wait ; вызываем функцию задержки по времени 	
RJMP Start ; возврат к метке Start, повторяем все в цикле 

;==============================================================
; -- подпрограмма задержки по времени -- 
; N = Delay*Fcpu/(r+2) // где r — число регистров  
; N = D*F/5 // D = 500ms = 0,5s ; F = 1000000 (1 МГц)
; N = 100 000 = 0,5 * 1 000 000 / 5    или  500мс * 1000 / 5  
Wait: ; N = 100000 = 0x0186a0 (500 милисекунд)
	LDI 	R18, BYTE3(Number) ; 0x01 ; старший байт N
	LDI 	R17, HIGH(Number) ; 0x86 ; средний байт N
	LDI 	R16, LOW(Number) ; 0xa0 ; младший байт N
Loop_Wait: 
	SUBI 	R16, 1 
	SBCI 	R17, 0
	SBCI 	R18, 0
	BRCC 	Loop_Wait
RET ; возврат из подпрограммы Wait 

