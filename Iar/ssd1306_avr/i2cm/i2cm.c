//------------------------------------------------------------------------------
// This is Open source software. You can place this code on your site, but don't
// forget a link to my YouTube-channel: https://www.youtube.com/channel/UChButpZaL5kUUl_zTyIDFkQ
// Это программное обеспечение распространяется свободно. Вы можете размещать
// его на вашем сайте, но не забудьте указать ссылку на мой YouTube-канал 
// "Электроника в объектике" https://www.youtube.com/channel/UChButpZaL5kUUl_zTyIDFkQ
// Автор: Надыршин Руслан / Nadyrshin Ruslan
//------------------------------------------------------------------------------
#include <ioavr.h>
#include <inavr.h>
#include "i2cm.h"



#define F_CPU 8000000UL


//==============================================================================
// Процедура инициализации i2c (I2C1 или I2C2) в режиме master с заданной частотой интерфейса
//==============================================================================
void i2cm_init(uint32_t i2c_clock)
{
  DDRC |= (1 << 4) | (1 << 5);
  TWBR = (uint8_t)(((F_CPU / i2c_clock) - 16) >> 1);
  // Сброс периферии TWI
  //TWCR = 0;
}
//==============================================================================


//==============================================================================
// Функция стартует обмен. Выдаёт условие START, выдаёт адрес слейва с признаком R/W
//==============================================================================
int8_t i2cm_Start(uint8_t slave_addr, uint8_t IsRead, uint16_t TimeOut)
{
  uint16_t TOcntr;
  
  // Выдаём условие START 
  TWCR = (1<<TWINT) | (1<<TWSTA) | (1<<TWEN);
  // Ожидаем окончания
  TOcntr = TimeOut;
  while (!(TWCR & (1<<TWINT)) && TOcntr) {TOcntr--;}

  // Ошибка при выдаче START
  if ((((TWSR & 0xF8) != TW_START) && ((TWSR & 0xF8) != TW_REP_START)) || !TOcntr)
    return I2C_ERR_HWerr; 
  
  // Выдаём адрес слейва
  TWDR = IsRead ? (slave_addr << 1) | 1 : slave_addr << 1;
  // Стартуем передачу адреса
  TWCR = (1<<TWINT) | (1<<TWEN);
  // Ждём окончания передачи
  TOcntr = TimeOut;
  while (!(TWCR & (1<<TWINT)) && TOcntr) {TOcntr--;}
  if (!TOcntr)
    return I2C_ERR_HWerr; 
	
  // Проверяем, подтвердил ли слейв получение адреса с признаком R/W
  uint8_t twst = TW_STATUS;
  if ( (twst != TW_MT_SLA_ACK) && (twst != TW_MR_SLA_ACK) ) 
    return I2C_ERR_NotConnect;
	
  return I2C_ERR_Ok;
}
//==============================================================================


//==============================================================================
// Функция выдаёт условие STOP
//==============================================================================
int8_t i2cm_Stop(uint16_t TimeOut)
{
  TWCR = (1<<TWINT) | (1<<TWEN) | (1<<TWSTO);
  return I2C_ERR_Ok;
}
//==============================================================================


//==============================================================================
// Функция выдаёт на шину массив байт из буфера
//==============================================================================
int8_t i2cm_WriteBuff(uint8_t *pbuf, uint16_t len, uint16_t TimeOut)
{
  uint16_t TOcntr;
  
  while (len--)
  {
    // Загружаем очередной байт в регистр TWDR
    TWDR = *(pbuf++);
    // Стартуем передачу
    TWCR = (1<<TWINT) | (1<<TWEN);
    // Ждём окончания передачи
    TOcntr = TimeOut;
    while (!(TWCR & (1<<TWINT)) && TOcntr) {TOcntr--;}
    if (!TOcntr)
      return I2C_ERR_HWerr;
    
    // Проверяем, получен ли ACK
    if( (TWSR & 0xF8) != TW_MT_DATA_ACK )
      return I2C_ERR_NotConnect;
  }
  
  return I2C_ERR_Ok;
}
//==============================================================================

//==============================================================================
// Функция читает с шины 1 байт с выдачей ACK
//==============================================================================
uint8_t i2cm_ReadByteACK(uint16_t TimeOut)
{
  uint16_t TOcntr;
  // Стартуем TWI с подтверждением ACK
  TWCR = (1<<TWINT) | (1<<TWEN) | (1<<TWEA); 
  // Ждём окончания приёма байта
  TOcntr = TimeOut;
  while (!(TWCR & (1<<TWINT)) && TOcntr) {TOcntr--;}
  // Возвращаем содержимое регистра TWDR
  return TWDR;
}
//==============================================================================


//==============================================================================
// Функция читает с шины 1 байт с выдачей NACK
//==============================================================================
uint8_t i2cm_ReadByteNACK(uint16_t TimeOut)
{
  uint16_t TOcntr;
  // Стартуем TWI без подтверждения ACK
  TWCR = (1<<TWINT) | (1<<TWEN);
  // Ждём окончания приёма байта
  TOcntr = TimeOut;
  while (!(TWCR & (1<<TWINT)) && TOcntr) {TOcntr--;}
  // Возвращаем содержимое регистра TWDR
  return TWDR;
}
//==============================================================================


//==============================================================================
// Функция читает массив байт с шины и выдаёт условие STOP
// Такой громоздкий код из-за особенностей реализации I2C в STM
//==============================================================================
int8_t i2cm_ReadBuffAndStop(uint8_t *pbuf, uint16_t len, uint16_t TimeOut)
{
  while (len--)
  {
    if (len)
      *(pbuf++) = i2cm_ReadByteACK(TimeOut);
    else
      *(pbuf++) = i2cm_ReadByteNACK(TimeOut);
  }
  
  i2cm_Stop(TimeOut);
  
  return 0;
}
//==============================================================================
