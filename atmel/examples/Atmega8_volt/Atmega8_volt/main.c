#include "main.h"

int main(void)
{
	adc_ini();// настройки ацп
	uint8_t status=0;// переменная статуса
	uint16_t adc_sred;// среднее значение АЦП
	uint16_t volt;// вольты
	sei();// глобально разрешить прерывания
	while (1)
    {
		switch(status){
			case 0:// старт блока преобразований
			adc_start();// просто стартуем 
			status=1;//и переходим в следующий статус -1.
			break;
			
			case 1:// проверка окончания блока преобразований
			if(adc_chek()) status=2;// если блок всё, переходим к статусу 3
			break;

			case 2://рассчеты и вывод на индикацию
			adc_sred=adc_get_summ()/200;// забираем сумму преобразований и вычисляем среднее арифметическое
			volt=3*adc_sred;// рассчитываем напряжение
			tm1637_indication_dot(volt, 2);// выводим на индикацию
			status=0;// переходим в статус 0
			break;
		}
    }
}

