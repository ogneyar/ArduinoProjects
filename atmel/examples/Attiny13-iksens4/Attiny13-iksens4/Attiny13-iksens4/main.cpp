#include "main.h"
#include "IR.h"
#define OUT PB2 // пин выхода устройства



volatile uint16_t count=0; // счетчик прерываний по таймеру
volatile uint8_t signal=0; // пременная для принятого сигнала
volatile uint16_t start; // стартовое значение count
volatile uint16_t dlinna; // длинна сигнала в тиках count
volatile uint8_t code; // код


// перерывание по таймеру
ISR (TIM0_COMPA_vect) {
	count++; // тик так
	if (count>=10000) // максимум для обнуления, при 5000 приемник не воспринимает сигнал
	{
		count=0;
	}
}


// прерывание по сигналу от приемника
ISR (PCINT0_vect) {
	if (!(PINB&(1<<RX)))
	{
		start=count; // начало сигнала
	} else {
		dlinna=count-start; // конец сигнала
		if (dlinna>=50) // если длинна в диапазоне
		{
			code|=(1<<signal);
		}
		signal++;
	}
}


	
int main(void)
{
	DDRB|=(1<<OUT); // выход 
	
	uint8_t stat=0; // статус датчика
	uint8_t trigger=0; // триггер флаг
	uint8_t mode=0; // режим работы
	IR_ini(); // настройки приема и предачи инфракрасного сигнала, все в куче
	sei();// разрешаем прерывания
	
//-----------читаем режим----------
	if (!(PINB&(1<<PB3)))
	{
		mode|=(1<<0);
	}
	if (!(PINB&(1<<PB4)))
	{
		mode|=(1<<1);
	}
//----------------------------------

    while (1) 
    {
		if (!count) // когда нуль - шлем и принимаем сигнал
		{
			signal=0; // 
			code=0;	//
			//IR_code(IR_CODE);// для протеуса
			IRR_code(IR_CODE); // для прошивки
			stat=status(code, 0);
		}

//-------- индикация припятствия--------------
		if (mode==0)
		{
			if (stat)
			{
				PORTB|=(1<<OUT); // врубаем
			} else
			{
				PORTB&=~(1<<OUT); // вырубаем
			}
		}
//------------------------------		
		
		
// -------------триггер	-------------
		if (mode==1)
		{
			if (stat)
			{
				if (trigger!=stat) 
				{
					PORTB^=(1<<OUT);// переключаемся
				}
			}
		trigger=stat;
		}
//--------------------------------

// ---------одновибратор 10 сек------------------
		if (mode==2)
		{
			if (stat)
			{
				cli();// прерывания ВЫКЛ.
				PORTB|=(1<<OUT); // врубление 
				_delay_ms(10000); // пауза
				PORTB&=~(1<<OUT); // вырубление
				status(1, 1); // сброс статиков внутри функции
				code=0; // обнуление 
				stat=0; // сброс статуса
				count=0; // обнул счетчика
				sei(); // прерывания ВКЛ.
			}
		}
//---------------------------------
		
// ---------одновибратор 60 сек------------------
		if (mode==3)
		{
			if (stat)
			{
				cli();// прерывания ВЫКЛ.
				PORTB|=(1<<OUT); // врубление
				_delay_ms(60000); // пауза
				PORTB&=~(1<<OUT); // вырубление
				status(1, 1); // сброс статиков внутри функции
				code=0; // обнуление
				stat=0; // сброс статуса
				count=0; // обнул счетчика
				sei(); // прерывания ВКЛ.
			}
		}
//---------------------------------

				
    }//w
}//m

